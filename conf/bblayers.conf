## conf/bblayers.conf
```bitbake
LCONF_VERSION = "7"

BBPATH = "${TOPDIR}"
BSPDIR := "${@os.path.abspath(os.path.dirname(d.getVar('FILE', True)) + '/../..')}"

BBFILES ?= ""
BBLAYERS = " \
  ${BSPDIR}/sources/poky/meta \
  ${BSPDIR}/sources/poky/meta-poky \
  \
  ${BSPDIR}/sources/meta-openembedded/meta-oe \
  ${BSPDIR}/sources/meta-openembedded/meta-multimedia \
  ${BSPDIR}/sources/meta-openembedded/meta-python \
  \
  ${BSPDIR}/sources/meta-freescale \
  ${BSPDIR}/sources/meta-freescale-3rdparty \
  ${BSPDIR}/sources/meta-freescale-distro \
"

# i.MX Yocto Project Release layers
BBLAYERS += "${BSPDIR}/sources/meta-imx/meta-bsp"
BBLAYERS += "${BSPDIR}/sources/meta-imx/meta-sdk"
BBLAYERS += "${BSPDIR}/sources/meta-imx/meta-ml"

BBLAYERS += "${BSPDIR}/sources/meta-arm/meta-arm"
BBLAYERS += "${BSPDIR}/sources/meta-arm/meta-arm-toolchain"
BBLAYERS += "${BSPDIR}/sources/meta-clang"
BBLAYERS += "${BSPDIR}/sources/meta-openembedded/meta-networking"
BBLAYERS += "${BSPDIR}/sources/meta-openembedded/meta-filesystems"
BBLAYERS += "${BSPDIR}/sources/meta-virtualization"
BBLAYERS += "${BSPDIR}/sources/meta-bsp-imx9"
BBLAYERS += " \
	${BSPDIR}/sources/meta-compulab \
	${BSPDIR}/sources/meta-compulab-bsp/meta-multimedia \
	${BSPDIR}/sources/meta-compulab-bsp/meta-graphics \
	${BSPDIR}/sources/meta-compulab-bsp/meta-utils \
	${BSPDIR}/sources/meta-compulab-bsp/meta-bsp \
	${BSPDIR}/sources/meta-compulab-bsp/meta-devtool \
	${BSPDIR}/sources/meta-compulab-uefi \
"
BBLAYERS += "/home/hieucao/DownKernel/compulab-nxp-bsp/sources/meta-satellite"
BBLAYERS += "/home/hieucao/DownKernel/compulab-nxp-bsp/sources/meta-editsource"
```

## conf/local.conf
```bitbake
MACHINE ??= 'ucm-imx93'
DISTRO ?= 'fsl-imx-xwayland'
#EXTRA_IMAGE_FEATURES ?= "debug-tweaks"
EXTRA_IMAGE_FEATURES ?= ""

USER_CLASSES ?= "buildstats"
PATCHRESOLVE = "noop"
BB_DISKMON_DIRS ??= "\
    STOPTASKS,${TMPDIR},1G,100K \
    STOPTASKS,${DL_DIR},1G,100K \
    STOPTASKS,${SSTATE_DIR},1G,100K \
    STOPTASKS,/tmp,100M,100K \
    HALT,${TMPDIR},100M,1K \
    HALT,${DL_DIR},100M,1K \
    HALT,${SSTATE_DIR},100M,1K \
    HALT,/tmp,10M,1K"
PACKAGECONFIG:append:pn-qemu-system-native = " sdl"
PACKAGECONFIG:append:pn-python3 = " tk"
PACKAGECONFIG:append:pn-gst-plugins-good = " v4l2 libv4l2"

CONF_VERSION = "2"

DL_DIR ?= "${BSPDIR}/downloads/"
ACCEPT_FSL_EULA = "1"

IMAGE_ROOTFS_EXTRA_SPACE = "1048576"

# Switch to Debian packaging and include package-management in the image
PACKAGE_CLASSES = "package_deb"
EXTRA_IMAGE_FEATURES += "package-management"
LICENSE_FLAGS_ACCEPTED = "commercial"

IMAGE_INSTALL:append = " packagegroup-core-buildessential "
#CORE_IMAGE_EXTRA_INSTALL += " cl-uboot cl-deploy cl-growfs-rootfs "
CORE_IMAGE_EXTRA_INSTALL += " libubootenv-bin u-boot-compulab-env "
CORE_IMAGE_EXTRA_INSTALL += " memtester htop iotop tmux iperf3 "
CORE_IMAGE_EXTRA_INSTALL += " libgpiod-tools can-utils minicom eeprom-util usbutils i2c-tools "
CORE_IMAGE_EXTRA_INSTALL += " dhcpcd ifupdown wpa-supplicant ntp "
CORE_IMAGE_EXTRA_INSTALL += " networkmanager "

DISTRO_FEATURES:remove = "sysvinit"

DISTRO_FEATURES:remove = "zeroconf"
hostname:pn-base-files = "pay-exp"

INHERIT += "extrausers"
INIT_MANAGER = "systemd"
# 1234
#ROOT_HASH="\$5\$LAqcfy8nE2kQ0q6b\$wfO1JnGimkdjXY0UrT4gj08NjvAvK6XTPbF3x65h7U7"
ROOT_HASH="\$5\$8pZmABsXX5LeXm4w\$zz4rRNp0pDul470L0qc29GNB6y2xkPfv7e4nAGKthl0"

# SLt@2025
#USER_HASH="\$5\$LAqcfy8nE2kQ0q6b\$wfO1JnGimkdjXY0UrT4gj08NjvAvK6XTPbF3x65h7U7"
USER_HASH="\$5\$btUDML6Z600H6FkX\$UxsDVJU8G5mvOV21/rANmddO15mA6y9yrspkvs8Zg2C"

EXTRA_USERS_PARAMS:append = "\
    usermod -p '${ROOT_HASH}' root; \
    usermod -s /bin/bash root; \
    useradd -p '${USER_HASH}' -s /bin/bash -m bee; \
    groupadd -r i2c; \
    groupadd -r spi; \
    groupadd -r gpio; \
    groupadd -r plugdev; \
    groupadd -r can; \
    usermod -a -G i2c,spi,gpio,plugdev,can,dialout,video,audio,tty,sudo bee; \
"
```

## meta-editsource/conf/layer.conf
```bitbake
# We have a conf and classes directory, add to BBPATH
BBPATH .= ":${LAYERDIR}"

# We have recipes-* directories, add to BBFILES
BBFILES += "${LAYERDIR}/recipes-*/*/*.bb \
            ${LAYERDIR}/recipes-*/*/*.bbappend"

BBFILE_COLLECTIONS += "meta-editsource"
BBFILE_PATTERN_meta-editsource = "^${LAYERDIR}/"
BBFILE_PRIORITY_meta-editsource = "6"

LAYERDEPENDS_meta-editsource = "core"
LAYERSERIES_COMPAT_meta-editsource = "mickledore"
```

## meta-satellite/conf/layer.conf
```bitbake
# We have a conf and classes directory, add to BBPATH
BBPATH .= ":${LAYERDIR}"

# We have recipes-* directories, add to BBFILES
BBFILES += "${LAYERDIR}/recipes-*/*/*.bb \
            ${LAYERDIR}/recipes-*/*/*.bbappend"

BBFILE_COLLECTIONS += "meta-satellite"
BBFILE_PATTERN_meta-satellite = "^${LAYERDIR}/"
BBFILE_PRIORITY_meta-satellite = "6"

LAYERDEPENDS_meta-satellite = "core"
LAYERSERIES_COMPAT_meta-satellite = "mickledore"
```
